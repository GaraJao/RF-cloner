#include <Wire.h>
#include <Adafruit_GFX.h>
#include <Adafruit_SSD1306.h>
#include <RCSwitch.h>

#define OLED_ADDRESS 0x3C // Endereço I2C do display OLED

Adafruit_SSD1306 display(128, 64, &Wire, -1);
RCSwitch mySwitch = RCSwitch();

String received_data = "";
String a_code = "";
String b_code = "";
int flag = 0;
int enterButton = 10, leftButton = 11, rightButton = 12, iPosition = 0;
bool enterPressed;


// 'navegation bar', 128x64px
const unsigned char bitmap_navegation [] PROGMEM = {
  0x00, 0x00, 0x00, 0x00, 0x00, 0x00, 0x00, 0x00, 0x00, 0x00, 0x00, 0x00, 0x00, 0x00, 0x00, 0x00, 
  0x00, 0xff, 0xff, 0xff, 0xff, 0x8f, 0xff, 0xff, 0xff, 0xfe, 0x01, 0xff, 0xff, 0xff, 0xfc, 0x00, 
  0x03, 0xff, 0xff, 0xff, 0xff, 0x8f, 0xff, 0xff, 0xff, 0xff, 0x81, 0xff, 0xff, 0xff, 0xff, 0x00, 
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  0x00, 0x00, 0x00, 0x00, 0x00, 0x00, 0x00, 0x00, 0x00, 0x00, 0x00, 0x00, 0x00, 0x00, 0x00, 0x00
};


// 'bruteForce', 128x64px
const unsigned char epd_bitmap_bruteForce [] PROGMEM = {
  0x00, 0x00, 0x00, 0x00, 0x00, 0x00, 0x00, 0x00, 0x00, 0x00, 0x00, 0x00, 0x00, 0x00, 0x00, 0x00, 
  0x00, 0xff, 0xff, 0xff, 0xff, 0x8f, 0xff, 0xff, 0xff, 0xfe, 0x01, 0xff, 0xff, 0xff, 0xfc, 0x00, 
  0x03, 0xff, 0xff, 0xff, 0xff, 0x8f, 0xff, 0xff, 0xff, 0xff, 0x81, 0xff, 0xff, 0xff, 0xff, 0x00, 
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  0xff, 0xff, 0xff, 0xff, 0xff, 0xff, 0xff, 0xff, 0xff, 0xff, 0xff, 0xff, 0xff, 0xff, 0xff, 0xfd
};
// 'enviar', 128x64px
const unsigned char epd_bitmap_enviar [] PROGMEM = {
  0x00, 0x00, 0x00, 0x00, 0x00, 0x00, 0x00, 0x00, 0x00, 0x00, 0x00, 0x00, 0x00, 0x00, 0x00, 0x00, 
  0x00, 0xff, 0xff, 0xff, 0xff, 0x8f, 0xff, 0xff, 0xff, 0xfe, 0x01, 0xff, 0xff, 0xff, 0xfc, 0x00, 
  0x03, 0xff, 0xff, 0xff, 0xff, 0x8f, 0xff, 0xff, 0xff, 0xff, 0x81, 0xff, 0xff, 0xff, 0xff, 0x00, 
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  0xff, 0xff, 0xff, 0xff, 0xff, 0xff, 0xff, 0xff, 0xff, 0xff, 0xff, 0xff, 0xff, 0xff, 0xff, 0xfd
};
// 'ouvir', 128x64px
const unsigned char epd_bitmap_ouvir [] PROGMEM = {
  0x00, 0x00, 0x00, 0x00, 0x00, 0x00, 0x00, 0x00, 0x00, 0x00, 0x00, 0x00, 0x00, 0x00, 0x00, 0x00, 
  0x00, 0xff, 0xff, 0xff, 0xff, 0x8f, 0xff, 0xff, 0xff, 0xfe, 0x01, 0xff, 0xff, 0xff, 0xfc, 0x00, 
  0x03, 0xff, 0xff, 0xff, 0xff, 0x8f, 0xff, 0xff, 0xff, 0xff, 0x81, 0xff, 0xff, 0xff, 0xff, 0x00, 
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  0xff, 0xff, 0xff, 0xff, 0xff, 0xff, 0xff, 0xff, 0xff, 0xff, 0xff, 0xff, 0xff, 0xff, 0xff, 0xfd
};


// Array of all bitmaps for convenience. (Total bytes used to store images = 3120)
int lenHome=3;
const unsigned char* bitmap_home[3] = {
    epd_bitmap_ouvir,
    epd_bitmap_enviar,
    epd_bitmap_bruteForce
  
};




void lerDados() {
  while (mySwitch.available()) {
    received_data = mySwitch.getReceivedValue();
    mySwitch.resetAvailable();
    
    switch (flag){
    case 0:
      a_code = received_data;
      flag = 1;
      break;
    default:
      if (a_code == received_data){
        continue; // Ignora o valor repetido e continua para a próxima iteração do loop
      }
      b_code = received_data;
      flag = 0;
      break;
    }
  }

  Serial.print("Código A = ");
  Serial.println(a_code);
  Serial.print("Código B = ");
  Serial.println(b_code);
}




void iniciarLeitura(){
  lerDados();
  


  
}


int menuPosition(int len) {
  int n = len-1;
  if(digitalRead(rightButton)==0){
    delay(200);
    iPosition++;
  }else if(digitalRead(leftButton)==0){
    delay(200);
    iPosition--;
  }
  if(iPosition>n){
    iPosition=0;
  }else if(iPosition<0){
    iPosition=n;
  }

}

bool enterStats() {
  if(digitalRead(enterButton) == 0){
  delay(250);
  enterPressed = true;
  return enterPressed;
  }

}

void drawHome(){
  menuPosition(lenHome);
  display.clearDisplay();
  display.drawBitmap(0, 0, bitmap_home[iPosition], 128, 64, SSD1306_WHITE);
  display.display();
  
}

void navegationOuvir(){
  int lenOuvir = 2;
  display.setTextSize(1);
  menuPosition(lenOuvir);
  display.drawBitmap(0, 0, bitmap_navegation, 128, 64, SSD1306_WHITE);
  display.drawRect(5, 16, 118, 36, SSD1306_WHITE);
  display.setTextColor(WHITE);

  display.setCursor(12, 55);
  display.print(" Voltar");
  display.setCursor(74, 55);
  display.print("Resetar");

  display.setTextSize(2);
  display.setCursor(11, 18);
  display.print(a_code);
  
  display.setCursor(11, 35);
  display.print(b_code);

  switch (iPosition){
    case 0: // Voltar
      display.setTextSize(1);
      display.fillRect(5, 53, 59, 16, SSD1306_WHITE);
      display.setTextColor(BLACK);
      display.setCursor(10, 55);
      display.print(" Voltar");
      break;

    default: // Resetar
      display.setTextSize(1);
      display.fillRect(64, 53, 59, 16, SSD1306_WHITE);
      display.setTextColor(BLACK);
      display.setCursor(74, 55);
      display.print("Resetar");
      
      if(enterPressed){ // reseta as variáveis
        a_code = "";
        b_code = "";
        enterPressed = 0;
      }

      break;
  }

  
  
}




void setup() {
  Serial.begin(9600);
  pinMode(rightButton, INPUT_PULLUP);
  pinMode(leftButton, INPUT_PULLUP);
  pinMode(enterButton, INPUT_PULLUP);
  display.begin(SSD1306_SWITCHCAPVCC, OLED_ADDRESS);
  display.clearDisplay();
  display.setTextColor(WHITE);
  mySwitch.enableReceive(0);  // Receiver on interrupt 0 => that is pin #2
}

void loop() {
  while(!enterPressed){
    enterStats();
    drawHome();
  }
  enterPressed = false;
  switch (iPosition){
  case 0: // Entra em ouvir sinais
    while(!enterPressed){
      display.clearDisplay();
      enterStats();
      navegationOuvir();
      lerDados();
      display.display();
    }
    iPosition = 0;
    enterPressed = false;
    break;
  
  default:

    
    break;
  }
  
  

  display.clearDisplay();
  


}
/*
 * teste 1 Código A = 143799829
           Código B = 119195496

   teste 2 Código A = 28238280 
           Código B = 143799829

   teste 3 Código A = 224714664
           Código B = 143799845

   teste 4 Código A = 143799845
           Código B = 66417304

   teste 5 Código A = 143799845
           Código B = 255806712




    




 */
